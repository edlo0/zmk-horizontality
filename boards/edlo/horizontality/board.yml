## boards/edlo/horizontality/board.yml
```yaml
board:
  extend: horizontality
  variants:
    - name: zmk
      qualifier: nrf52840
```

## config/west.yml
```yaml
manifest:
  defaults:
    revision: v0.3
  remotes:
    - name: zmkfirmware
      url-base: https://github.com/zmkfirmware
    # Additional modules containing boards/shields/custom code can be listed here as well
    # See https://docs.zephyrproject.org/3.2.0/develop/west/manifest.html#projects
  projects:
    - name: zmk
      remote: zmkfirmware
      import: app/west.yml
    - name: NAU7802_LOADCELL
      path: modules/nau7802_loadcell
      revision: refs/tags/zephyr-v3.7.0
      url: https://github.com/elvishuynh/nau7802_loadcell_zephyr_driver/
  self:
    path: config
```
